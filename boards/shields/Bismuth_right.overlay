#include "Bismuth.dtsi"

&default_transform { 
    col-offset = <6>;
};

&kscan0 {
    col-gpios
        = <&pro_micro 4 GPIO_ACTIVE_HIGH> //Inner
        , <&pro_micro 5 GPIO_ACTIVE_HIGH> //Index
        , <&pro_micro 6 GPIO_ACTIVE_HIGH> //Middle
        , <&pro_micro 7 GPIO_ACTIVE_HIGH> //Ring
        , <&pro_micro 8 GPIO_ACTIVE_HIGH> //Pinky
        , <&pro_micro 9 GPIO_ACTIVE_HIGH> //Outer
        ;
};
