## boards/shields/Kconfig.shield
```kconfig
config SHIELD_BISMUTH_LEFT
    def_bool $(shields_list_contains,bismuth_left)

config SHIELD_BISMUTH_RIGHT
    def_bool $(shields_list_contains,bismuth_right)
```

## config/boards/shields/bismuth/Kconfig.defconfig
```kconfig
if SHIELD_BISMUTH_LEFT

config ZMK_KEYBOARD_NAME
    default "Bismuth"

config ZMK_SPLIT_ROLE_CENTRAL
    default y

endif

if SHIELD_BISMUTH_LEFT || SHIELD_BISMUTH_RIGHT

config ZMK_SPLIT
    default y

endif
```
